## Kconfig
```kconfig
menu "mUPnP"

    config MUPNP_THREAD_STACK_SIZE
        int "mUPnP worker stack size (bytes)"
        range 4096 65536
        default 8192
        help
            Stack allocated for each mUPnP pthread. XML device and service
            descriptions are parsed on worker threads. Increase this for
            deeply nested descriptions or application callbacks with large
            stack usage. Measure the stack high-water mark on your hardware.

endmenu
```

## examples/espidf/control_point/main/Kconfig.projbuild
```kconfig
menu "mUPnP control point example"

    config MUPNP_EXAMPLE_WIFI_SSID
        string "Wi-Fi SSID"
        default ""

    config MUPNP_EXAMPLE_WIFI_PASSWORD
        string "Wi-Fi password"
        default ""
        help
            This value is stored in plaintext in sdkconfig and the firmware.
            Do not commit credentials. Leave empty for an open test network.

    config MUPNP_EXAMPLE_SEARCH_INTERVAL
        int "SSDP search interval (seconds)"
        range 10 3600
        default 30

endmenu
```
