## components/mupnp/Kconfig
```kconfig
menu "mUPnP Configuration"

config MUPNP_ENABLE_SSDP
    bool "Enable SSDP (Service Discovery)"
    default y
    help
        Enable SSDP for UPnP device discovery.
        This is required for both control points and devices.

config MUPNP_SSDP_ANNOUNCE_INTERVAL
    int "SSDP Announce Interval (seconds)"
    depends on MUPNP_ENABLE_SSDP
    default 1800
    range 300 7200
    help
        Interval between SSDP NOTIFY announcements in seconds.
        UPnP specification recommends less than half of the cache-control max-age.

config MUPNP_HTTP_SERVER_ENABLE
    bool "Enable HTTP Server for Device"
    default y
    help
        Enable HTTP server for hosting device and service descriptions.
        Required for UPnP devices.

config MUPNP_HTTP_SERVER_PORT
    int "HTTP Server Port"
    depends on MUPNP_HTTP_SERVER_ENABLE
    default 80
    range 1 65535
    help
        Port number for the HTTP server used by UPnP devices.

config MUPNP_CONTROLPOINT_ENABLE
    bool "Enable Control Point Functionality"
    default y
    help
        Enable UPnP control point (client) functionality.
        This allows the device to discover and control other UPnP devices.

config MUPNP_DEVICE_ENABLE
    bool "Enable Device Functionality"
    default y
    help
        Enable UPnP device (server) functionality.
        This allows the ESP32 to act as a UPnP device.

config MUPNP_EVENTING_ENABLE
    bool "Enable UPnP Eventing"
    default y
    help
        Enable UPnP event notification (GENA).
        This allows devices to notify control points of state changes.

config MUPNP_THREAD_STACK_SIZE
    int "Thread Stack Size (bytes)"
    default 4096
    range 2048 16384
    help
        Stack size for mUPnP worker threads.
        Increase if experiencing stack overflow issues.

config MUPNP_MAX_INTERFACES
    int "Maximum Network Interfaces"
    default 2
    range 1 4
    help
        Maximum number of network interfaces to monitor.
        Typically 1 (WiFi STA) or 2 (WiFi STA + AP).

config MUPNP_MULTICAST_TTL
    int "Multicast TTL"
    default 4
    range 1 255
    help
        Time-To-Live for multicast packets.
        UPnP specification recommends TTL of 4.

config MUPNP_LOG_LEVEL
    int "mUPnP Log Level"
    default 3
    range 0 5
    help
        Log level for mUPnP library:
        0 = None
        1 = Error
        2 = Warning
        3 = Info
        4 = Debug
        5 = Verbose

config MUPNP_USE_PERSISTENT_CONNECTIONS
    bool "Use Persistent HTTP Connections"
    default n
    help
        Enable HTTP persistent connections (HTTP/1.1 keep-alive).
        May reduce overhead but increases memory usage.

endmenu
```

## examples/esp32/control_point/sdkconfig.defaults
```kconfig
# ESP32 mUPnP Control Point - SDK Configuration Defaults

# WiFi Configuration
CONFIG_ESP_WIFI_SSID="your-wifi-ssid"
CONFIG_ESP_WIFI_PASSWORD="your-wifi-password"

# Enable LWIP features required for UPnP/SSDP
CONFIG_LWIP_IGMP=y
CONFIG_LWIP_SO_REUSE=y
CONFIG_LWIP_SO_RCVBUF=y

# Increase network buffer sizes for UPnP
CONFIG_LWIP_TCP_MSS=1460
CONFIG_LWIP_TCP_WND_DEFAULT=5840
CONFIG_LWIP_TCP_SND_BUF_DEFAULT=2920
CONFIG_LWIP_UDP_RECVMBOX_SIZE=16
CONFIG_LWIP_TCPIP_RECVMBOX_SIZE=32

# Enable multicast support
CONFIG_LWIP_MULTICAST_TX_OPTIONS=y

# Task stack sizes
CONFIG_ESP_MAIN_TASK_STACK_SIZE=4096
CONFIG_ESP_SYSTEM_EVENT_TASK_STACK_SIZE=3072

# Increase default thread priority
CONFIG_FREERTOS_UNICORE=n

# Enable full C++ exception support (for XML parsing if needed)
CONFIG_COMPILER_CXX_EXCEPTIONS=y

# Logging
CONFIG_LOG_DEFAULT_LEVEL_INFO=y
CONFIG_LOG_MAXIMUM_LEVEL_VERBOSE=y

# mUPnP specific settings
CONFIG_MUPNP_ENABLE_SSDP=y
CONFIG_MUPNP_CONTROLPOINT_ENABLE=y
CONFIG_MUPNP_THREAD_STACK_SIZE=4096
CONFIG_MUPNP_LOG_LEVEL=3
CONFIG_MUPNP_MULTICAST_TTL=4
```

## examples/esp32/device/sdkconfig.defaults
```kconfig
# ESP32 mUPnP Device - SDK Configuration Defaults

# WiFi Configuration
# IMPORTANT: Change these values to your actual WiFi credentials
# For production, consider using NVS encryption or a secure provisioning method
CONFIG_ESP_WIFI_SSID="CHANGE_ME"
CONFIG_ESP_WIFI_PASSWORD="CHANGE_ME"

# Enable LWIP features required for UPnP/SSDP
CONFIG_LWIP_IGMP=y
CONFIG_LWIP_SO_REUSE=y
CONFIG_LWIP_SO_RCVBUF=y

# Increase network buffer sizes for UPnP
CONFIG_LWIP_TCP_MSS=1460
CONFIG_LWIP_TCP_WND_DEFAULT=5840
CONFIG_LWIP_TCP_SND_BUF_DEFAULT=2920
CONFIG_LWIP_UDP_RECVMBOX_SIZE=16
CONFIG_LWIP_TCPIP_RECVMBOX_SIZE=32

# Enable multicast support
CONFIG_LWIP_MULTICAST_TX_OPTIONS=y

# HTTP Server settings
CONFIG_LWIP_MAX_LISTENING_TCP=16

# Task stack sizes
CONFIG_ESP_MAIN_TASK_STACK_SIZE=4096
CONFIG_ESP_SYSTEM_EVENT_TASK_STACK_SIZE=3072

# Enable full C++ exception support
CONFIG_COMPILER_CXX_EXCEPTIONS=y

# Logging
CONFIG_LOG_DEFAULT_LEVEL_INFO=y
CONFIG_LOG_MAXIMUM_LEVEL_VERBOSE=y

# mUPnP specific settings
CONFIG_MUPNP_ENABLE_SSDP=y
CONFIG_MUPNP_DEVICE_ENABLE=y
CONFIG_MUPNP_HTTP_SERVER_ENABLE=y
CONFIG_MUPNP_HTTP_SERVER_PORT=80
CONFIG_MUPNP_THREAD_STACK_SIZE=4096
CONFIG_MUPNP_LOG_LEVEL=3
CONFIG_MUPNP_MULTICAST_TTL=4
CONFIG_MUPNP_SSDP_ANNOUNCE_INTERVAL=1800
```
